## fs/Kconfig
```kconfig
#
# File system configuration
#

menu "File systems"

if BLOCK

source "fs/ext2/Kconfig"
source "fs/ext3/Kconfig"
source "fs/ext4/Kconfig"

config FS_XIP
# execute in place
	bool
	depends on EXT2_FS_XIP
	default y

source "fs/jbd/Kconfig"
source "fs/jbd2/Kconfig"

config FS_MBCACHE
# Meta block cache for Extended Attributes (ext2/ext3/ext4)
	tristate
	default y if EXT2_FS=y && EXT2_FS_XATTR
	default y if EXT3_FS=y && EXT3_FS_XATTR
	default y if EXT4_FS=y && EXT4_FS_XATTR
	default m if EXT2_FS_XATTR || EXT3_FS_XATTR || EXT4_FS_XATTR

source "fs/reiserfs/Kconfig"
source "fs/jfs/Kconfig"

config FS_POSIX_ACL
# Posix ACL utility routines (for now, only ext2/ext3/jfs/reiserfs/nfs4)
#
# NOTE: you can implement Posix ACLs without these helpers (XFS does).
# 	Never use this symbol for ifdefs.
#
	bool
	default n

config FILE_LOCKING
	bool "Enable POSIX file locking API" if EMBEDDED
	default y
	help
	  This option enables standard file locking support, required
          for filesystems like NFS and for the flock() system
          call. Disabling this option saves about 11k.

source "fs/xfs/Kconfig"
source "fs/gfs2/Kconfig"
source "fs/ocfs2/Kconfig"
source "fs/btrfs/Kconfig"

endif # BLOCK

source "fs/notify/Kconfig"

config QUOTA
	bool "Quota support"
	help
	  If you say Y here, you will be able to set per user limits for disk
	  usage (also called disk quotas). Currently, it works for the
	  ext2, ext3, and reiserfs file system. ext3 also supports journalled
	  quotas for which you don't need to run quotacheck(8) after an unclean
	  shutdown.
	  For further details, read the Quota mini-HOWTO, available from
	  <http://www.tldp.org/docs.html#howto>, or the documentation provided
	  with the quota tools. Probably the quota support is only useful for
	  multi user systems. If unsure, say N.

config QUOTA_NETLINK_INTERFACE
	bool "Report quota messages through netlink interface"
	depends on QUOTA && NET
	help
	  If you say Y here, quota warnings (about exceeding softlimit, reaching
	  hardlimit, etc.) will be reported through netlink interface. If unsure,
	  say Y.

config PRINT_QUOTA_WARNING
	bool "Print quota warnings to console (OBSOLETE)"
	depends on QUOTA
	default y
	help
	  If you say Y here, quota warnings (about exceeding softlimit, reaching
	  hardlimit, etc.) will be printed to the process' controlling terminal.
	  Note that this behavior is currently deprecated and may go away in
	  future. Please use notification via netlink socket instead.

# Generic support for tree structured quota files. Seleted when needed.
config QUOTA_TREE
	 tristate

config QFMT_V1
	tristate "Old quota format support"
	depends on QUOTA
	help
	  This quota format was (is) used by kernels earlier than 2.4.22. If
	  you have quota working and you don't want to convert to new quota
	  format say Y here.

config QFMT_V2
	tristate "Quota format v2 support"
	depends on QUOTA
	select QUOTA_TREE
	help
	  This quota format allows using quotas with 32-bit UIDs/GIDs. If you
	  need this functionality say Y here.

config QUOTACTL
	bool
	depends on XFS_QUOTA || QUOTA
	default y

source "fs/autofs/Kconfig"
source "fs/autofs4/Kconfig"
source "fs/fuse/Kconfig"

config GENERIC_ACL
	bool
	select FS_POSIX_ACL

if BLOCK
menu "CD-ROM/DVD Filesystems"

source "fs/isofs/Kconfig"
source "fs/udf/Kconfig"

endmenu
endif # BLOCK

if BLOCK
menu "DOS/FAT/NT Filesystems"

source "fs/fat/Kconfig"
source "fs/ntfs/Kconfig"

endmenu
endif # BLOCK

menu "Pseudo filesystems"

source "fs/proc/Kconfig"
source "fs/sysfs/Kconfig"

config TMPFS
	bool "Virtual memory file system support (former shm fs)"
	help
	  Tmpfs is a file system which keeps all files in virtual memory.

	  Everything in tmpfs is temporary in the sense that no files will be
	  created on your hard drive. The files live in memory and swap
	  space. If you unmount a tmpfs instance, everything stored therein is
	  lost.

	  See <file:Documentation/filesystems/tmpfs.txt> for details.

config TMPFS_POSIX_ACL
	bool "Tmpfs POSIX Access Control Lists"
	depends on TMPFS
	select GENERIC_ACL
	help
	  POSIX Access Control Lists (ACLs) support permissions for users and
	  groups beyond the owner/group/world scheme.

	  To learn more about Access Control Lists, visit the POSIX ACLs for
	  Linux website <http://acl.bestbits.at/>.

	  If you don't know what Access Control Lists are, say N.

config HUGETLBFS
	bool "HugeTLB file system support"
	depends on X86 || IA64 || PPC64 || SPARC64 || (SUPERH && MMU) || \
		   (S390 && 64BIT) || BROKEN
	help
	  hugetlbfs is a filesystem backing for HugeTLB pages, based on
	  ramfs. For architectures that support it, say Y here and read
	  <file:Documentation/vm/hugetlbpage.txt> for details.

	  If unsure, say N.

config HUGETLB_PAGE
	def_bool HUGETLBFS

source "fs/configfs/Kconfig"

endmenu

menuconfig MISC_FILESYSTEMS
	bool "Miscellaneous filesystems"
	default y
	---help---
	  Say Y here to get to see options for various miscellaneous
	  filesystems, such as filesystems that came from other
	  operating systems.

	  This option alone does not add any kernel code.

	  If you say N, all options in this submenu will be skipped and
	  disabled; if unsure, say Y here.

if MISC_FILESYSTEMS

source "fs/adfs/Kconfig"
source "fs/affs/Kconfig"
source "fs/ecryptfs/Kconfig"
source "fs/hfs/Kconfig"
source "fs/hfsplus/Kconfig"
source "fs/befs/Kconfig"
source "fs/bfs/Kconfig"
source "fs/efs/Kconfig"
source "fs/jffs2/Kconfig"
# UBIFS File system configuration
source "fs/ubifs/Kconfig"
source "fs/cramfs/Kconfig"
source "fs/squashfs/Kconfig"
source "fs/freevxfs/Kconfig"
source "fs/minix/Kconfig"
source "fs/omfs/Kconfig"
source "fs/hpfs/Kconfig"
source "fs/qnx4/Kconfig"
source "fs/romfs/Kconfig"
source "fs/sysv/Kconfig"
source "fs/ufs/Kconfig"

endif # MISC_FILESYSTEMS

menuconfig NETWORK_FILESYSTEMS
	bool "Network File Systems"
	default y
	depends on NET
	---help---
	  Say Y here to get to see options for network filesystems and
	  filesystem-related networking code, such as NFS daemon and
	  RPCSEC security modules.

	  This option alone does not add any kernel code.

	  If you say N, all options in this submenu will be skipped and
	  disabled; if unsure, say Y here.

if NETWORK_FILESYSTEMS

source "fs/nfs/Kconfig"
source "fs/nfsd/Kconfig"

config LOCKD
	tristate

config LOCKD_V4
	bool
	depends on NFSD_V3 || NFS_V3
	default y

config EXPORTFS
	tristate

config NFS_ACL_SUPPORT
	tristate
	select FS_POSIX_ACL

config NFS_COMMON
	bool
	depends on NFSD || NFS_FS
	default y

source "net/sunrpc/Kconfig"
source "fs/smbfs/Kconfig"
source "fs/cifs/Kconfig"
source "fs/ncpfs/Kconfig"
source "fs/coda/Kconfig"
source "fs/afs/Kconfig"
source "fs/9p/Kconfig"

endif # NETWORK_FILESYSTEMS

if BLOCK
menu "Partition Types"

source "fs/partitions/Kconfig"

endmenu
endif

source "fs/nls/Kconfig"
source "fs/dlm/Kconfig"

config AUFS
	tristate "Another unionfs"
	help
	Aufs is a stackable unification filesystem such as Unionfs,
	which unifies several directories and provides a merged single
	directory.
	In the early days, aufs was entirely re-designed and
	re-implemented Unionfs Version 1.x series. After many original
	ideas, approaches and improvements, it becomes totally
	different from Unionfs while keeping the basic features.
	See Unionfs for the basic features.

if AUFS
choice
	prompt "Maximum number of branches"
	default AUFS_BRANCH_MAX_127
	help
	HELP


config AUFS_BRANCH_MAX_127
	bool "127"
	help
	HELP

config AUFS_BRANCH_MAX_511
	bool "511"
	help
	HELP

config AUFS_BRANCH_MAX_1023
	bool "1023"
	help
	HELP

config AUFS_BRANCH_MAX_32767
	bool "32767"
	help
	HELP

endchoice

config AUFS_STAT
	bool "Use <sysfs>/fs/aufs/stat"
	depends on SYSFS
	help
	Shows some statistic data via <sysfs>/fs/aufs/stat.
	See detail in aufs.5.

comment "SYSFS and AUFS_STAT are disabled"
	depends on SYSFS = n

config AUFS_HINOTIFY
	bool "Use inotify to detect actions on a branch"
	depends on INOTIFY
	help
	If you want to modify files on branches directly, eg. bypassing aufs,
	and want aufs to detect the changes of them fully, then enable this
	option and use 'udba=inotify' mount option.
	It will have a negative impact to the performance.
	See detail in aufs.5.

comment "INOTIFY and AUFS_HINOTIFY are disabled"
	depends on INOTIFY = n

config AUFS_EXPORT
	bool "NFS-exportable aufs"
	depends on (AUFS = y && EXPORTFS = y) || (AUFS = m && EXPORTFS)
	help
	If you want to export your mounted aufs, then enable this
	option. There are several requirements for this configuration.
	See detail in aufs.5.

comment "EXPORTFS and AUFS_EXPORT are disabled"
	depends on EXPORTFS = n

comment "AUFS_EXPORT is disabled since EXPORTFS is a module but AUFS"
	depends on EXPORTFS = m && AUFS = y

config AUFS_INO_T_64
	bool 
	depends on 64BIT && !(ALPHA || S390)
	default y

config AUFS_ROBR
	bool "Aufs as an readonly branch of another aufs mount"
	help
	If you want make your aufs to be a part of another aufs, then
	enable this option. In other words, you can specify your aufs
	path in 'br:' mount option for another aufs, but cannot
	specify 'rw' as the branch permission.
	It will have a negative impact to the performance.
	See detail in aufs.5.

config AUFS_DLGT
	bool "Delegate the internal branch access the kernel thread"
	help
	If you want aufs to delegate
	the internal access to the branches which is made by aufs, to
	the kernel thread, in order to hide the access issued by your
	application from your LSM or something or make your
	application to be traced strictly by the task I/O accounting,
	then enable this option and use 'dlgt' mount option.
	It will have a negative impact to the performance.
	See detail in aufs.5.

config AUFS_HIN_OR_DLGT
	bool 
	depends on AUFS_HINOTIFY || AUFS_DLGT
	default y
	help
	Automatic configuration for internal use.

config AUFS_SHWH
	bool "Show whiteouts"
	help
	If you want to make the whiteouts in aufs visible, then enable
	this option and specify 'shwh' mount option. Although it may
	sounds like philosophy or something, but in technically it
	simply shows the name of whiteout with keeping its behaviour.

config AUFS_RR_SQUASHFS
	bool "Make squashfs branch RR (real readonly) by default"
	default y
	help
	If you use squashfs or LZMA patched squashfs as an aufs branch
	and want to set '=rr' to it by default, then enable this
	configuration.

config AUFS_SEC_PERM_PATCH
	bool "sec_perm-2.6.24.patch was applied or not"
	depends on AUFS = m
	depends on SECURITY
	help
	If you build aufs as a module and enabled CONFIG_SECURITY,
	then you need to apply the patch
	CVS_TREE/aufs/patch/sec_perm-2.6.24.patch to your kernel
	source, and enable this configuration.
	The sec_perm-2.6.24.patch exports a kernel function
	security_inode_permission() to modules.

comment "SECURITY and AUFS_SEC_PERM_PATCH are disabled"
	depends on SECURITY = n

config AUFS_SPLICE_PATCH
	bool "splice.patch for sendfile(2) and splice(2)"
	help
	If you use 'loopback mount' on a fs-image file, or use
	splice(2) or sendfile(2) systemcall in aufs, then you need to
	apply the patch 'CVS_TREE/aufs/patch/splice.patch' to your
	kernel source, and enable this configuration.
	The splice.patch makes the kernel function do_splice_to/from()
	global and exports them to modules.

config AUFS_LHASH_PATCH
	bool "lhash.patch for NFS branch"
	depends on NFS_FS
	help
	If you use mounted NFS as an aufs branch filesystem, then you
	need to apply the patch 'CVS_TREE/aufs/patch/lhash.patch' (or
	lhash-2.6.22.patch for linux-2.6.22 and later) to your kernel
	source, and enable this configuration.
	The patch file makes the kernel function __lookup_hash() global
	and exports it to modules.

comment "NFS_FS and AUFS_LHASH_PATCH are disabled"
	depends on NFS_FS = n

config AUFS_PUT_FILP_PATCH
	bool "put_filp.patch for 'atomic open'"
	depends on AUFS = m && NFS_V4
	help
	If you build aufs as a module and use a filesystem which
	operates 'atomic open' (for instance NFSv4) as an aufs branch
	filesystem, then you need to apply the patch
	'CVS_TREE/aufs/patch/put_filp.patch' to your kernel source,
	and enable this configuration.
	The put_filp.patch exports a kernel function put_filp() to
	modules.

comment "NFS_V4 and AUFS_PUT_FILP_PATCH are disabled"
	depends on NFS_V4 = n

config AUFS_BR_NFS
	bool 
	depends on NFS_FS
	depends on AUFS_LHASH_PATCH
	default y
	help
	Automatic configuration for internal use.
	When aufs supports NFS branch, enabled automatically.

config AUFS_BR_NFS_V4
	bool 
	depends on NFS_V4 && AUFS_BR_NFS
	depends on AUFS = y || (AUFS = m && AUFS_PUT_FILP_PATCH)
	default y
	help
	Automatic configuration for internal use.
	When aufs supports a branch filesystem which operates
	'atomic_open', for instance NFSv4, this configuration is enabled
	automatically.

config AUFS_BR_XFS
	bool 
	depends on XFS_FS
	default y
	help
	Automatic configuration for internal use.
	When aufs supports XFS branch, enabled automatically.

config AUFS_FSYNC_SUPER_PATCH
	bool "fsync_super-2.6.xx.patch was applied or not"
	depends on AUFS = m
	help
	If you build aufs as a module and want to flush everything for
	branch filesystems which are not marked as 'rr' nor 'rr+wh' at
	umount or remount time, then you need to apply the patch
	'CVS_TREE/aufs/patch/fsync_super-2.6.16.patch' or
	'...-2.6.19.patch' to your kernel source, and enable this
	configuration.
	It may be helpful at shutdown time in case of your aufs is a
	root filesystem. But this behaviour will not guarantee the
	consistency of branch filesystems. To guarantee it, try the
	approach described in the aufs manual, and do not forget
	installing auplink script.
	The fsync_super-2.6.xx.patch does nothing but exports a kernel
	function fsync_super() to modules.

config AUFS_DENY_WRITE_ACCESS_PATCH
	bool "deny_write_access.patch was applied or not"
	depends on AUFS = m
	help
	A security enhancement to deny writing to a running executable
	which exists on an aufs branch filesystem and executed through
	aufs. If you applied
	'CVS_TREE/aufs/patch/deny_write_access.patch' to your kernel
	and you are compiling aufs as a module, then enable this
	option.
	The write_deny_access.patch does nothing but export the
	function.

config AUFS_WORKAROUND_FUSE
	bool "Special handling for FUSE-based filesystem"
	depends on FUSE_FS
	help
	A FUSE-based filesystem may not initialize its inode
	attributes and the FUSE developer thinks the inode attributes
	in a positive dentry which is returned by VFS lookup operation
	are not reliable.
	If you use a FUSE-based filesystem as an aufs branch, and it
	customizes the inode attribute on it without overriding
	fuse_lowlevel_ops.lookup, probably you need to enable this
	configuration.
	If you enable this configuration, aufs calls getattr operation
	in every lookup and revalidate operation for the FUSE-based
	filesystem branch.
	It will have a negative impact to the performance even if you do
	not use a FUSE-based filesystem branch.

config AUFS_GETATTR
	bool 
	depends on AUFS_HINOTIFY || AUFS_WORKAROUND_FUSE || AUFS_BR_NFS
	default y
	help
	Automatic configuration for internal use.

config AUFS_DEBUG
	bool "Debug aufs"
	default y
	help
	Enable this to compile aufs internal debug code.
	It will have a negative impact to the performance.

config AUFS_MAGIC_SYSRQ
	bool
	depends on AUFS_DEBUG && MAGIC_SYSRQ
	default y
	help
	Automatic configuration for internal use.
	When aufs supports Magic SysRq, enabled automatically.

config AUFS_DEBUG_LOCK
	bool "Show lock status in Magic SysRq"
	depends on AUFS_MAGIC_SYSRQ
	help
	For developers only. Sometimes it is useful when a deadlock
	occurs in aufs. Trace every aufs lock acquire and release, and
	print them when Magic SysRq-<AUFS> key is pressed.
	It will have a huge negative impact to the performance.

config AUFS_COMPAT
	bool "Compatibility with Unionfs (obsolete)"
	help
	This makes aufs compatible with unionfs-style mount options and some
	behaviours.
	The dirs= mount option and =nfsro branch permission flag are always
	interpreted as br: mount option and =ro flag respectively. The
	'debug', 'delete' and 'imap' mount options are ignored.
	If you disable this option, you will get,
	- aufs issues a warning about the ignored mount options
	- the default branch permission flag is set. RW for the first branch,
	  and RO for the rests.
	- the name of a internal file which represents the directory is
	  'opaque', becomes '.wh..wh..opq'
	- the 'diropq=w' mount option is set by default


config AUFS_UNIONFS22_PATCH
	bool "Unionfs-2.2 or later patch is applied or not (obsolete)"
	help
	HELP
		
config AUFS_UNIONFS23_PATCH
	bool "Unionfs-2.3 or later patch is applied or not (obsolete)"
	select AUFS_SPLICE_PATCH
	select AUFS_UNIONFS22_PATCH
	help
	HELP

endif

endmenu
```
